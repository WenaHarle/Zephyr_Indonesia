## 03-struktur-dan-konfigurasi-aplikasi/src/Kconfig
```kconfig
menu "Konfigurasi Aplikasi Logging"

config LOG_INTERVAL_MS
	int "Interval logging dalam milidetik"
	default 1000
	help
	  Interval antara satu baris log periodik dengan berikutnya.
	  Ubah nilai ini lewat prj.conf, jangan hardcode di main.c.

endmenu

source "Kconfig.zephyr"
```

## 06-porting-dan-bring-up-board/boards/others/zi_wroom_s3/Kconfig.defconfig
```kconfig
# SPDX-License-Identifier: Apache-2.0

if BOARD_ZI_WROOM_S3

config BOARD
	default "zi_wroom_s3"

endif # BOARD_ZI_WROOM_S3
```

## 06-porting-dan-bring-up-board/boards/others/zi_wroom_s3/Kconfig.zi_wroom_s3
```kconfig
# Board kustom berbasis modul ESP32-S3-WROOM telanjang (bukan DevKitC-1).
# SPDX-License-Identifier: Apache-2.0

config BOARD_ZI_WROOM_S3
	bool
```

## 06-porting-dan-bring-up-board/boards/others/zi_wroom_s3/board.yml
```yaml
board:
  name: zi_wroom_s3
  vendor: others
  socs:
    - name: esp32s3
      cpuclusters:
        - name: procpu
        - name: appcpu
```

## 06-porting-dan-bring-up-board/boards/others/zi_wroom_s3/zi_wroom_s3_esp32s3_procpu_defconfig
```kconfig
# Defconfig board level, cukup pastikan console dan GPIO aktif.
# Sisanya (clock, cache, dst) sudah didapat dari default SoC ESP32-S3.
CONFIG_SOC_SERIES_ESP32S3=y
CONFIG_SERIAL=y
CONFIG_CONSOLE=y
CONFIG_UART_CONSOLE=y
CONFIG_GPIO=y
```
