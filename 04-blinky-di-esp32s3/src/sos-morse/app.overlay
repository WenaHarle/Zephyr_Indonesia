/* Sama persis dengan overlay di src/external-led/app.overlay */
/ {
	leds {
		compatible = "gpio-leds";
		led0: led_0 {
			gpios = <&gpio0 4 GPIO_ACTIVE_HIGH>;
			label = "LED Eksternal";
		};
	};

	aliases {
		led0 = &led0;
	};
};
