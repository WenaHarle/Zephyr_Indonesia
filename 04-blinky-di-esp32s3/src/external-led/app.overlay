/*
 * LED eksternal di GPIO4 (pin aman, bukan strapping pin).
 * Binding gpio-leds sudah tersedia bawaan Zephyr, tinggal pakai.
 */
/ {
	leds {
		compatible = "gpio-leds";
		led0: led_0 {
			gpios = <&gpio0 4 GPIO_ACTIVE_HIGH>;
			label = "LED Eksternal";
		};
	};

	aliases {
		led0 = &led0;
	};
};
